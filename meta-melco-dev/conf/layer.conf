## meta-melco-dev/conf/layer.conf
```bitbake
# We have a conf and classes directory, add to BBPATH
BBPATH .= ":${LAYERDIR}"

# We have recipes-* directories, add to BBFILES
BBFILES += "${LAYERDIR}/recipes-*/*/*.bb \
        ${LAYERDIR}/recipes-*/*/*.bbappend"

BBFILE_COLLECTIONS += "melco-dev"
BBFILE_PATTERN_melco-dev = "^${LAYERDIR}/"
BBFILE_PRIORITY_melco-dev = "7"
```
